## blu-common/blu-components/Kconfig
```kconfig
menu "BluControl Configuration"

    choice BLUCONTROL_BUTTONS_PRESS_STATE
        prompt "State when pressing buttons"
        default BLUCONTROL_BUTTONS_PRESS_STATE_LOW
        help
            Select whether the buttons are pressed when in LOW (Ground) or HIGH (3.3)

        config BLUCONTROL_BUTTONS_PRESS_STATE_LOW
            bool "LOW State"

        config BLUCONTROL_BUTTONS_PRESS_STATE_HIGH
            bool "HIGH State"
    endchoice

    menu "Buttons"
        #Buttons
        config BLUCONTROL_BUTTON_A_GPIO
            string "Button A GPIO"
            default ""
            help
                GPIO Number for the A Button. Empty if the controller doesn't have that button. Multiple GPIOs can be defined with a space between them

        config BLUCONTROL_BUTTON_B_GPIO
            string "Button B GPIO"
            default ""
            help
                GPIO Number for the B Button. Empty if the controller doesn't have that button. Multiple GPIOs can be defined with a space between them

        config BLUCONTROL_BUTTON_Y_GPIO
            string "Button Y GPIO"
            default ""
            help
                GPIO Number for the Y Button. Empty if the controller doesn't have that button. Multiple GPIOs can be defined with a space between them

        config BLUCONTROL_BUTTON_X_GPIO
            string "Button X GPIO"
            default ""
            help
                GPIO Number for the X Button. Empty if the controller doesn't have that button. Multiple GPIOs can be defined with a space between them

        config BLUCONTROL_DPAD_RIGHT_GPIO
            string "DPAD Right GPIO"
            default ""
            help
                GPIO Number for the DPAD Right. Empty if the controller doesn't have that button. Multiple GPIOs can be defined with a space between them

        config BLUCONTROL_DPAD_DOWN_GPIO
            string "DPAD Down GPIO"
            default ""
            help
                GPIO Number for the DPAD Down. Empty if the controller doesn't have that button. Multiple GPIOs can be defined with a space between them

        config BLUCONTROL_DPAD_LEFT_GPIO
            string "DPAD Left GPIO"
            default ""
            help
                GPIO Number for the DPAD Left. Empty if the controller doesn't have that button. Multiple GPIOs can be defined with a space between them

        config BLUCONTROL_DPAD_UP_GPIO
            string "DPAD Up GPIO"
            default ""
            help
                GPIO Number for the DPAD Up. Empty if the controller doesn't have that button. Multiple GPIOs can be defined with a space between them

        config BLUCONTROL_BUTTON_L_GPIO
            string "Button L GPIO"
            default ""
            help
                GPIO Number for the L Button. Empty if the controller doesn't have that button. Multiple GPIOs can be defined with a space between them

        config BLUCONTROL_BUTTON_ZL_GPIO
            string "Button ZL GPIO"
            default ""
            help
                GPIO Number for the ZL Button. Empty if the controller doesn't have that button. Multiple GPIOs can be defined with a space between them

        config BLUCONTROL_BUTTON_R_GPIO
            string "Button R GPIO"
            default ""
            help
                GPIO Number for the R Button. Empty if the controller doesn't have that button. Multiple GPIOs can be defined with a space between them

        config BLUCONTROL_BUTTON_ZR_GPIO
            string "Button ZR GPIO"
            default ""
            help
                GPIO Number for the ZR Button. Empty if the controller doesn't have that button. Multiple GPIOs can be defined with a space between them

        config BLUCONTROL_BUTTON_START_GPIO
            string "Button START GPIO"
            default ""
            help
                GPIO Number for the START Button. Empty if the controller doesn't have that button. Multiple GPIOs can be defined with a space between them

        config BLUCONTROL_BUTTON_SELECT_GPIO
            string "Button SELECT GPIO"
            default ""
            help
                GPIO Number for the SELECT Button. Empty if the controller doesn't have that button. Multiple GPIOs can be defined with a space between them

        config BLUCONTROL_BUTTON_HOME_GPIO
            string "Button HOME GPIO"
            default ""
            help
                GPIO Number for the HOME Button. Empty if the controller doesn't have that button. Multiple GPIOs can be defined with a space between them

        config BLUCONTROL_BUTTON_CAPTURE_GPIO
            string "Button CAPTURE GPIO"
            default ""
            help
                GPIO Number for the CAPTURE Button. Empty if the controller doesn't have that button. Multiple GPIOs can be defined with a space between them

        config BLUCONTROL_BUTTON_STICK_L_GPIO
            string "Button Stick L (L3) GPIO"
            default ""
            help
                GPIO Number for the Left Stick Button. Empty if the controller doesn't have that button. Multiple GPIOs can be defined with a space between them

        config BLUCONTROL_BUTTON_STICK_R_GPIO
            string "Button Stick R (R3) GPIO"
            default ""
            help
                GPIO Number for the Right Stick Button. Empty if the controller doesn't have that button. Multiple GPIOs can be defined with a space between them
    endmenu

    menu "Triggers"
        choice BLUCONTROL_LEFT_TRIGGER_MODE
            prompt "Left trigger mode"
            default BLUCONTROL_LEFT_TRIGGER_NONE
            help
                Select the type of input for the left trigger

            config BLUCONTROL_LEFT_TRIGGER_NONE
                bool "Disabled"

            config BLUCONTROL_LEFT_TRIGGER_ANALOG
                bool "Analog"
        endchoice

        config BLUCONTROL_LEFT_TRIGGER_GPIO
            int "Left trigger GPIO"
            default 36
            depends on BLUCONTROL_LEFT_TRIGGER_ANALOG
            help
                GPIO Number for the Left Trigger Axis.

        config BLUCONTROL_LEFT_TRIGGER_IS_INVERTED
            bool "Is left trigger inverted?"
            default false
            depends on BLUCONTROL_LEFT_TRIGGER_ANALOG
            help
                Check if left trigger has inverted values
        
        config BLUCONTROL_LEFT_TRIGGER_ACT
            int "Left trigger activation"
            default 10
            range 0 100
            depends on BLUCONTROL_LEFT_TRIGGER_ANALOG
            help
                Percentage to activate the left trigger as a button. 0 to disable it. 100 to activate only on fully pressed
        
        choice BLUCONTROL_RIGHT_TRIGGER_MODE
            prompt "Right trigger mode"
            default BLUCONTROL_RIGHT_TRIGGER_NONE
            help
                Select the type of input for the right trigger

            config BLUCONTROL_RIGHT_TRIGGER_NONE
                bool "Disabled"

            config BLUCONTROL_RIGHT_TRIGGER_ANALOG
                bool "Analog"
        endchoice

        config BLUCONTROL_RIGHT_TRIGGER_GPIO
            int "Right trigger GPIO"
            default 39
            depends on BLUCONTROL_RIGHT_TRIGGER_ANALOG
            help
                GPIO Number for the Right Trigger Axis.
        
        config BLUCONTROL_RIGHT_TRIGGER_IS_INVERTED
            bool "Is right trigger inverted?"
            default false
            depends on BLUCONTROL_RIGHT_TRIGGER_ANALOG
            help
                Check if right trigger has inverted values
        
        config BLUCONTROL_RIGHT_TRIGGER_ACT
            int "Right trigger activation"
            default 10
            range 0 100
            depends on BLUCONTROL_RIGHT_TRIGGER_ANALOG
            help
                Percentage to activate the right trigger as a button. 0 to disable it. 100 to activate only on fully pressed
    endmenu

    menu "Sticks"
        menu "Left Stick"
            #Left Stick

            choice BLUCONTROL_LEFT_STICK_MODE
                prompt "Left stick mode"
                default BLUCONTROL_LEFT_STICK_NONE
                help
                    Select the type of input for the left stick

                config BLUCONTROL_LEFT_STICK_NONE
                    bool "Disabled"

                config BLUCONTROL_LEFT_STICK_ANALOG
                    bool "Analog"

                config BLUCONTROL_LEFT_STICK_N64
                    bool "N64 stick"

                config BLUCONTROL_LEFT_STICK_BUTTONS
                    bool "Buttons"
            endchoice

            #Analog

            config BLUCONTROL_LEFT_STICK_X
                int "Left Stick X Axis"
                default 32
                depends on BLUCONTROL_LEFT_STICK_ANALOG
                help
                    GPIO Number for the Left Stick X Axis.

            config BLUCONTROL_LEFT_STICK_Y
                int "Left Stick Y Axis"
                default 33
                depends on BLUCONTROL_LEFT_STICK_ANALOG
                help
                    GPIO Number for the Left Stick Y Axis.

            choice BLUCONTROL_LEFT_STICK_X_MODE
                prompt "Left stick X axis mode"
                default BLUCONTROL_LEFT_STICK_X_NORMAL
                depends on BLUCONTROL_LEFT_STICK_ANALOG
                help
                    Select the mode for the left stick X axis

                config BLUCONTROL_LEFT_STICK_X_NORMAL
                    bool "Normal"

                config BLUCONTROL_LEFT_STICK_X_INVERTED
                    bool "Inverted"
            endchoice

            choice BLUCONTROL_LEFT_STICK_Y_MODE
                prompt "Left stick Y axis mode"
                default BLUCONTROL_LEFT_STICK_Y_NORMAL
                depends on BLUCONTROL_LEFT_STICK_ANALOG
                help
                    Select the mode for the left stick Y axis

                config BLUCONTROL_LEFT_STICK_Y_NORMAL
                    bool "Normal"

                config BLUCONTROL_LEFT_STICK_Y_INVERTED
                    bool "Inverted"
            endchoice

            #N64

            config BLUCONTROL_LEFT_STICK_X1
                int "Left Stick X Axis Interrupt"
                default 32
                range 0 50
                depends on BLUCONTROL_LEFT_STICK_N64
                help
                    GPIO Number for the Left Stick X Axis Interrupt.

            config BLUCONTROL_LEFT_STICK_X2
                int "Left Stick X Axis Counter"
                default 33
                range 0 50
                depends on BLUCONTROL_LEFT_STICK_N64
                help
                    GPIO Number for the Left Stick X Axis Counter.

            config BLUCONTROL_LEFT_STICK_Y1
                int "Left Stick Y Axis Interrupt"
                default 34
                range 0 50
                depends on BLUCONTROL_LEFT_STICK_N64
                help
                    GPIO Number for the Left Stick Y Axis Interrupt.

            config BLUCONTROL_LEFT_STICK_Y2
                int "Left Stick Y Axis Counter"
                default 35
                range 0 50
                depends on BLUCONTROL_LEFT_STICK_N64
                help
                    GPIO Number for the Left Stick Y Axis Counter.

                    #Buttons

            config BLUCONTROL_LEFT_STICK_X_MAX
                int "Left Stick X Axis Positive"
                default 32
                range 0 50
                depends on BLUCONTROL_LEFT_STICK_BUTTONS
                help
                    GPIO Number for the Left Stick X Axis Positive.

            config BLUCONTROL_LEFT_STICK_X_MIN
                int "Left Stick X Axis Negative"
                default 33
                range 0 50
                depends on BLUCONTROL_LEFT_STICK_BUTTONS
                help
                    GPIO Number for the Left Stick X Axis Negative.

            config BLUCONTROL_LEFT_STICK_Y_MAX
                int "Left Stick Y Axis Positive"
                default 34
                range 0 50
                depends on BLUCONTROL_LEFT_STICK_BUTTONS
                help
                    GPIO Number for the Left Stick Y Axis Positive.

            config BLUCONTROL_LEFT_STICK_Y_MIN
                int "Left Stick Y Axis Negative"
                default 35
                range 0 50
                depends on BLUCONTROL_LEFT_STICK_BUTTONS
                help
                    GPIO Number for the Left Stick Y Axis Negative.
        endmenu

        menu "Right stick"
            #Right Stick

            choice BLUCONTROL_RIGHT_STICK_MODE
                prompt "Right stick mode"
                default BLUCONTROL_RIGHT_STICK_NONE
                help
                    Select the type of input for the right stick

                config BLUCONTROL_RIGHT_STICK_NONE
                    bool "Disabled"

                config BLUCONTROL_RIGHT_STICK_ANALOG
                    bool "Analog"

                config BLUCONTROL_RIGHT_STICK_N64
                    bool "N64 stick"

                config BLUCONTROL_RIGHT_STICK_BUTTONS
                    bool "Buttons"
            endchoice

            #Analog

            config BLUCONTROL_RIGHT_STICK_X
                int "Right Stick X Axis"
                default 36
                depends on BLUCONTROL_RIGHT_STICK_ANALOG
                help
                    GPIO Number for the Right Stick X Axis.

            config BLUCONTROL_RIGHT_STICK_Y
                int "Right Stick Y Axis"
                default 37
                depends on BLUCONTROL_RIGHT_STICK_ANALOG
                help
                    GPIO Number for the Right Stick Y Axis.

            choice BLUCONTROL_RIGHT_STICK_X_MODE
                prompt "Right stick X axis mode"
                default BLUCONTROL_RIGHT_STICK_X_NORMAL
                depends on BLUCONTROL_RIGHT_STICK_ANALOG
                help
                    Select the mode for the right stick X axis

                config BLUCONTROL_RIGHT_STICK_X_NORMAL
                    bool "Normal"

                config BLUCONTROL_RIGHT_STICK_X_INVERTED
                    bool "Inverted"
            endchoice

            choice BLUCONTROL_RIGHT_STICK_Y_MODE
                prompt "Right stick Y axis mode"
                default BLUCONTROL_RIGHT_STICK_Y_NORMAL
                depends on BLUCONTROL_RIGHT_STICK_ANALOG
                help
                    Select the mode for the right stick Y axis

                config BLUCONTROL_RIGHT_STICK_Y_NORMAL
                    bool "Normal"

                config BLUCONTROL_RIGHT_STICK_Y_INVERTED
                    bool "Inverted"
            endchoice

            #N64

            config BLUCONTROL_RIGHT_STICK_X1
                int "Right Stick X Axis Interrupt"
                default 36
                range 0 50
                depends on BLUCONTROL_RIGHT_STICK_N64
                help
                    GPIO Number for the Right Stick X Axis Interrupt.

            config BLUCONTROL_RIGHT_STICK_X2
                int "Right Stick X Axis Counter"
                default 37
                range 0 50
                depends on BLUCONTROL_RIGHT_STICK_N64
                help
                    GPIO Number for the Right Stick X Axis Counter.

            config BLUCONTROL_RIGHT_STICK_Y1
                int "Right Stick Y Axis Interrupt"
                default 38
                range 0 50
                depends on BLUCONTROL_RIGHT_STICK_N64
                help
                    GPIO Number for the Right Stick Y Axis Interrupt.

            config BLUCONTROL_RIGHT_STICK_Y2
                int "Right Stick Y Axis Counter"
                default 39
                range 0 50
                depends on BLUCONTROL_RIGHT_STICK_N64
                help
                    GPIO Number for the Right Stick Y Axis Counter.

            #Buttons

            config BLUCONTROL_RIGHT_STICK_X_MAX
                int "Right Stick X Axis Positive"
                default 36
                range 0 50
                depends on BLUCONTROL_RIGHT_STICK_BUTTONS
                help
                    GPIO Number for the Right Stick X Axis Positive.

            config BLUCONTROL_RIGHT_STICK_X_MIN
                int "Right Stick X Axis Negative"
                default 37
                range 0 50
                depends on BLUCONTROL_RIGHT_STICK_BUTTONS
                help
                    GPIO Number for the Right Stick X Axis Negative.

            config BLUCONTROL_RIGHT_STICK_Y_MAX
                int "Right Stick Y Axis Positive"
                default 38
                range 0 50
                depends on BLUCONTROL_RIGHT_STICK_BUTTONS
                help
                    GPIO Number for the Right Stick Y Axis Positive.

            config BLUCONTROL_RIGHT_STICK_Y_MIN
                int "Right Stick Y Axis Negative"
                default 39
                range 0 50
                depends on BLUCONTROL_RIGHT_STICK_BUTTONS
                help
                    GPIO Number for the Right Stick Y Axis Negative.
        endmenu
    endmenu

    menu "Rumble"
        config BLUCONTROL_RUMBLE_LEFT_GPIO
            int "Left rumble GPIO"
            default -1
            help
                GPIO Number for the left side rumble motor. -1 if not present.
        config BLUCONTROL_RUMBLE_RIGHT_GPIO
            int "Right rumble GPIO"
            default -1
            help
                GPIO Number for the right side rumble motor. -1 if not present.
        config BLUCONTROL_BLE_NEW_ADDRESS_EACH_BOOT
            bool "BlueRetro mode: new Bluetooth address at every power-on"
            default n
            help
                The controller shows up as a brand new device at every power-on, so the
                host always does a fresh pairing instead of a reconnection. Works around
                hosts that pair the first time but never reconnect.
        config BLUCONTROL_RUMBLE_MIN_POWER
            int "Minimum motor power (0-255)"
            default 0
            range 0 255
            help
                Any non-zero rumble request below this value is raised to it, so weak
                requests still make a small ERM motor spin. 0 keeps requests unchanged.
        config BLUCONTROL_RUMBLE_MAX_ON_MS
            int "Safety: max continuous rumble time in ms (0 = no limit)"
            default 0
            range 0 600000
            help
                Stops the motor if it stays on this long without any new rumble command.
    endmenu

    menu "Energy control"
        choice BLUCONTROL_ENERGY_MODE
            prompt "Energy mode"
            default BLUCONTROL_ENERGY_MODE_SWITCH
            help
                Select the type of energy mode (i.e. how the control turns on/off)

            config BLUCONTROL_ENERGY_MODE_SWITCH
                bool "Battery switch"

            config BLUCONTROL_ENERGY_MODE_SOFTWARE
                bool "Software"
        endchoice

        config BLUCONTROL_ENERGY_POWER_OFF_SECONDS
            int "Power off seconds"
            default 60
            range 60 600
            depends on BLUCONTROL_ENERGY_MODE_SOFTWARE
            help
                Seconds before turning off the controller if it's not connected to any device.

        config BLUCONTROL_ENERGY_POWER_LED_GPIO
            int "Power led GPIO"
            default 0
            range 0 39 if IDF_TARGET_ESP32
            range 0 46 if IDF_TARGET_ESP32S2
            range 0 48 if IDF_TARGET_ESP32S3
            range 0 21 if IDF_TARGET_ESP32C3
            range 0 40 if IDF_TARGET_ESP32H2_BETA_VERSION_1
            range 0 25 if IDF_TARGET_ESP32H2_BETA_VERSION_2
            range 0 20 if IDF_TARGET_ESP32C2
            depends on BLUCONTROL_ENERGY_MODE_SOFTWARE
            help
                GPIO Number for the power led. This is mandatory for energy management by software.
        
        choice BLUCONTROL_LEDS_MODE
            prompt "LEDs GPIO mode"
            default BLUCONTROL_LEDS_MODE_HIGH
            help
                Select how the LEDs have to turn on.
        
            config BLUCONTROL_LEDS_MODE_HIGH
                depends on !BLUCONTROL_ENERGY_MODE_SOFTWARE
                bool "On HIGH value (GPIO gives 3.3v to the LED)"
        
            config BLUCONTROL_LEDS_MODE_LOW
                bool "On LOW value (GPIO acts like GND)"
        endchoice
        
        choice BLUCONTROL_ENERGY_WAKING_MODE
            prompt "Waking mode"
            default BLUCONTROL_ENERGY_WAKING_MODE_LOW
            depends on BLUCONTROL_ENERGY_MODE_SOFTWARE
            help
                Select the type of waking mode while sleeping (i.e. how the control turns on)

            config BLUCONTROL_ENERGY_WAKING_MODE_HIGH
                bool "HIGH State: ANY button on HIGH (3.3V) will wake up"

            config BLUCONTROL_ENERGY_WAKING_MODE_LOW
                bool "LOW State: ALL buttons MUST be pressed on LOW (Ground)"
        endchoice
        
        config BLUCONTROL_ENERGY_BUTTONS_LENGTH
            int "Wake-Up buttons length"
            default 1
            range 1 3
            depends on BLUCONTROL_ENERGY_MODE_SOFTWARE
            help
                Count of buttons for Waking up the Controller. If the state for pressing buttons is on LOW State, then ALL buttons MUST be pressed in order to waking up the controller. Otherwise, if the buttons are pressing on HIGH State, then the controller will wake up if any of the following buttons is being pressed.
        
        config BLUCONTROL_ENERGY_BUTTON1_GPIO
            int "Waking-up Button 1 GPIO"
            default 0
            range 0 39 if IDF_TARGET_ESP32
            range 0 46 if IDF_TARGET_ESP32S2
            range 0 48 if IDF_TARGET_ESP32S3
            range 0 21 if IDF_TARGET_ESP32C3
            range 0 40 if IDF_TARGET_ESP32H2_BETA_VERSION_1
            range 0 25 if IDF_TARGET_ESP32H2_BETA_VERSION_2
            range 0 20 if IDF_TARGET_ESP32C2
            depends on BLUCONTROL_ENERGY_MODE_SOFTWARE
            help
                GPIO Number for the Button 1 for waking up the controller. Must be a RTC GPIO, otherwise it'll not work.
        
        config BLUCONTROL_ENERGY_BUTTON2_GPIO
            int "Waking-up Button 2 GPIO"
            default 0
            range 0 39 if IDF_TARGET_ESP32
            range 0 46 if IDF_TARGET_ESP32S2
            range 0 48 if IDF_TARGET_ESP32S3
            range 0 21 if IDF_TARGET_ESP32C3
            range 0 40 if IDF_TARGET_ESP32H2_BETA_VERSION_1
            range 0 25 if IDF_TARGET_ESP32H2_BETA_VERSION_2
            range 0 20 if IDF_TARGET_ESP32C2
            depends on BLUCONTROL_ENERGY_MODE_SOFTWARE && BLUCONTROL_ENERGY_BUTTONS_LENGTH >= 2
            help
                GPIO Number for the Button 2 for waking up the controller. Must be a RTC GPIO, otherwise it'll not work.
        
        config BLUCONTROL_ENERGY_BUTTON3_GPIO
            int "Waking-up Button 3 GPIO"
            default 0
            range 0 39 if IDF_TARGET_ESP32
            range 0 46 if IDF_TARGET_ESP32S2
            range 0 48 if IDF_TARGET_ESP32S3
            range 0 21 if IDF_TARGET_ESP32C3
            range 0 40 if IDF_TARGET_ESP32H2_BETA_VERSION_1
            range 0 25 if IDF_TARGET_ESP32H2_BETA_VERSION_2
            range 0 20 if IDF_TARGET_ESP32C2
            depends on BLUCONTROL_ENERGY_MODE_SOFTWARE && BLUCONTROL_ENERGY_BUTTONS_LENGTH >= 3
            help
                GPIO Number for the Button 3 for waking up the controller. Must be a RTC GPIO, otherwise it'll not work.

        config BLUCONTROL_ENERGY_POWER_ON_MS
            int "Hold time to power on (ms)"
            default 3000
            range 0 10000
            depends on BLUCONTROL_ENERGY_MODE_SOFTWARE
            help
                Waking-up Button 1 must be held this long after waking up, otherwise the
                controller goes straight back to sleep (no accidental power-on in a bag).

        config BLUCONTROL_ENERGY_POWER_OFF_MS
            int "Hold time to power off (ms)"
            default 5000
            range 1000 20000
            depends on BLUCONTROL_ENERGY_MODE_SOFTWARE
            help
                Holding Waking-up Button 1 alone this long while running puts the controller
                to deep sleep (power off).

        config BLUCONTROL_ENERGY_OTA_BUTTON_GPIO
            int "Button held with the power button to enter OTA mode at power-on"
            default -1
            depends on BLUCONTROL_ENERGY_MODE_SOFTWARE
            help
                Holding Waking-up Button 1 and this button from power-on enters the OTA
                (update) mode. Also cancels the power-off hold. -1 to disable.

        config BLUCONTROL_ENERGY_OTA_MS
            int "Hold time from power-on to enter OTA mode (ms)"
            default 6000
            range 1000 20000
            depends on BLUCONTROL_ENERGY_MODE_SOFTWARE

        config BLUCONTROL_ENERGY_PERIPH_POWER_GPIO
            int "GPIO that switches the controller power on (-1 = none)"
            default -1
            range -1 33
            depends on BLUCONTROL_ENERGY_MODE_SOFTWARE
            help
                Driven HIGH while the controller runs, LOW (and held) in deep sleep.
                Used to cut the 5 V of a Dreamcast pad through a MOSFET switch.
    endmenu

    menu "GameCube pad read through its cable (Joybus)"
        config BLUCONTROL_GC_CABLE
            bool "Read an original GameCube pad through its cable data line"
            default n
            help
                The ESP32 acts as the console on the pad's data wire (red).
                Needs a 1k pull-up from the data line to 3V3.

        config BLUCONTROL_GC_DATA_GPIO
            int "GameCube data GPIO (red wire)"
            default 21
            range 0 31
            depends on BLUCONTROL_GC_CABLE
    endmenu

    menu "Dreamcast (Maple bus)"
        config BLUCONTROL_DREAMCAST
            bool "Read an original Dreamcast pad through its Maple bus"
            default n
            help
                The ESP32 acts as the console on the pad's 5-pin cable header.

        config BLUCONTROL_MAPLE_A_GPIO
            int "Maple SDCKA GPIO (pad header pin 1)"
            default 21
            range 0 31
            depends on BLUCONTROL_DREAMCAST

        config BLUCONTROL_MAPLE_B_GPIO
            int "Maple SDCKB GPIO (pad header pin 5)"
            default 22
            range 0 31
            depends on BLUCONTROL_DREAMCAST
    endmenu

    menu "Advanced"
        config BLUCONTROL_ANALOG_VREF
            int "Default vRef for analog values"
            default 1079
            depends on BLUCONTROL_LEFT_STICK_ANALOG || BLUCONTROL_RIGHT_STICK_ANALOG || BLUCONTROL_LEFT_TRIGGER_ANALOG || BLUCONTROL_RIGHT_TRIGGER_ANALOG
            help
                Default voltage reference value when reading analog values. This is just in case your ESP32 doesn't has this value written on its eFuse.
    endmenu
endmenu
```
